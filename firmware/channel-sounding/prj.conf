## CMakeLists.txt
```
# SPDX-License-Identifier: MIT

cmake_minimum_required(VERSION 3.20.0)

find_package(Zephyr REQUIRED HINTS $ENV{ZEPHYR_BASE})
project(channel_sounding)

target_sources(app PRIVATE src/main.c src/data_out.c)

# One application, two roles. The role .conf file selects which side is built.
target_sources_ifdef(CONFIG_APP_ROLE_INITIATOR app PRIVATE src/ranging_cs_initiator.c)
target_sources_ifdef(CONFIG_APP_ROLE_REFLECTOR app PRIVATE src/ranging_cs_reflector.c)
```

## Kconfig
```
menu "Channel sounding app"

choice APP_ROLE
	prompt "Role of this board"
	default APP_ROLE_INITIATOR

config APP_ROLE_INITIATOR
	bool "Initiator"
	help
	  Scans for the reflector, connects, runs Channel Sounding and works
	  out the distance. Results are printed on its UART.

config APP_ROLE_REFLECTOR
	bool "Reflector"
	help
	  Advertises, accepts the connection and answers the sounding.
	  It does not compute a distance itself.

endchoice

config APP_PEER_NAME
	string "Advertised name of the reflector"
	default "cs-reflector"
	help
	  The reflector advertises this name and the initiator only connects
	  to a device with this exact name, so it never connects to an
	  unrelated device.

if APP_ROLE_INITIATOR

choice APP_STEP_MODE
	prompt "Channel Sounding step mode"
	default APP_STEP_MODE_2_SUB_1

config APP_STEP_MODE_2_SUB_1
	bool "Mode 2 with mode 1 sub steps (phase + round trip time)"

config APP_STEP_MODE_2
	bool "Mode 2 only (phase based ranging)"

config APP_STEP_MODE_1
	bool "Mode 1 only (round trip time)"

endchoice

config APP_PROCEDURE_INTERVAL
	int "Connection events between two CS procedures"
	default 10
	range 2 100
	help
	  With a 20 ms connection interval, 10 means one distance about
	  every 200 ms. Lower is faster but each procedure has less time.

endif

config APP_POWER_BANK_LOAD
	bool "Draw extra current so a power bank does not switch off"
	help
	  Keeps the CPU awake and lights the spare LEDs. This adds only a few
	  mA, but some power banks switch off when the load is close to zero.

endmenu

source "Kconfig.zephyr"
```

## Kconfig.sysbuild
```
# nRF54L is single core, the radio controller runs next to the app.
# No partition manager needed on the secure build.
config PARTITION_MANAGER
	default n if !BOARD_IS_NON_SECURE

source "share/sysbuild/Kconfig"
```

## prj.conf
```kconfig
# Settings shared by both roles. Role specific settings are in role_*.conf.

CONFIG_NCS_SAMPLES_DEFAULTS=y
CONFIG_DK_LIBRARY=y

CONFIG_BT=y
CONFIG_BT_SMP=y
CONFIG_BT_MAX_CONN=1
CONFIG_BT_BONDABLE=n

CONFIG_BT_CHANNEL_SOUNDING=y
CONFIG_BT_RAS=y

# The Ranging Service needs an MTU of at least 247, because the reflector sends
# its step data over GATT after every procedure.
CONFIG_BT_L2CAP_TX_MTU=498
CONFIG_BT_BUF_ACL_TX_SIZE=502
CONFIG_BT_BUF_ACL_RX_SIZE=502
CONFIG_BT_CTLR_DATA_LENGTH_MAX=251

# One antenna on each DK, so buffers are sized for one antenna path only.
CONFIG_BT_RAS_MODE_3_SUPPORTED=n
CONFIG_BT_RAS_MAX_ANTENNA_PATHS=1
CONFIG_BT_CTLR_SDC_CS_MAX_ANTENNA_PATHS=1
CONFIG_BT_CTLR_SDC_CS_NUM_ANTENNAS=1
CONFIG_BT_CTLR_SDC_CS_STEP_MODE3=n
CONFIG_BT_CTLR_CHANNEL_SOUNDING_TEST=n

# Lets CS and the normal link run on different PHYs.
CONFIG_BT_TRANSMIT_POWER_CONTROL=y

CONFIG_REBOOT=y

# Lets data_out.c read and report the link PHY.
CONFIG_BT_USER_PHY_UPDATE=y
```

## role_initiator.conf
```kconfig
CONFIG_APP_ROLE_INITIATOR=y

CONFIG_BT_CENTRAL=y
CONFIG_BT_GATT_CLIENT=y
CONFIG_BT_GATT_DYNAMIC_DB=y
CONFIG_BT_ATT_PREPARE_COUNT=3
CONFIG_BT_RAS_RREQ=y

CONFIG_BT_SCAN=y
CONFIG_BT_SCAN_FILTER_ENABLE=y
CONFIG_BT_SCAN_NAME_CNT=1

CONFIG_BT_CTLR_SDC_CS_ROLE_INITIATOR_ONLY=y

# Nordic distance estimation library, which uses floating point on every procedure.
CONFIG_BT_CS_DE=y
# A 2048 point IFFT makes one bin 0.073 m instead of 0.29 m with the default 512.
CONFIG_BT_CS_DE_2048_NFFT=y
CONFIG_BT_CS_DE_MAX_NUM_ANTENNA_PATHS=1
CONFIG_FPU=y
CONFIG_FPU_SHARING=y
CONFIG_CBPRINTF_FP_SUPPORT=y
```

## role_reflector.conf
```kconfig
CONFIG_APP_ROLE_REFLECTOR=y

CONFIG_BT_PERIPHERAL=y
CONFIG_BT_DEVICE_NAME="cs-reflector"
CONFIG_BT_GAP_AUTO_UPDATE_CONN_PARAMS=n
CONFIG_BT_CTLR_PHY_2M=y
CONFIG_BT_RAS_RRSP=y

CONFIG_BT_CTLR_SDC_CS_ROLE_REFLECTOR_ONLY=y

# PHY changes are left to the initiator.
CONFIG_BT_AUTO_PHY_UPDATE=n

# Many USB power banks switch off when the load is very small. This keeps a
# small constant load so the reflector stays powered during long runs.
CONFIG_APP_POWER_BANK_LOAD=y
```

## boards/nrf54l15dk_nrf54l15_cpuapp.overlay
```dts
// SPDX-License-Identifier: LicenseRef-Nordic-5-Clause
// Antenna switch pins, taken from Nordic's ras samples for this DK.
/ {
	cs_antenna_switch: cs-antenna-config {
		status = "okay";
		compatible = "nordic,bt-cs-antenna-switch";
		ant-gpios = <&gpio1 11 GPIO_ACTIVE_HIGH>,
			    <&gpio1 12 GPIO_ACTIVE_HIGH>,
			    <&gpio1 13 GPIO_ACTIVE_HIGH>,
			    <&gpio1 14 GPIO_ACTIVE_HIGH>;
		multiplexing-mode = <0>;
	};
};
```

## boards/nrf54lm20dk_nrf54lm20b_cpuapp.overlay
```dts
// SPDX-License-Identifier: LicenseRef-Nordic-5-Clause
// Antenna switch pins, taken from Nordic's ras samples for this DK.
/ {
	cs_antenna_switch: cs-antenna-config {
		status = "okay";
		compatible = "nordic,bt-cs-antenna-switch";
		ant-gpios = <&gpio1 17 GPIO_ACTIVE_HIGH>,
			    <&gpio1 18 GPIO_ACTIVE_HIGH>,
			    <&gpio1 19 GPIO_ACTIVE_HIGH>,
			    <&gpio1 20 GPIO_ACTIVE_HIGH>;
		multiplexing-mode = <0>;
	};
};
```

## src/main.c
```c
// Copyright (c) 2026 the ble-ranging authors
// SPDX-License-Identifier: MIT

#include <zephyr/kernel.h>
#include <zephyr/bluetooth/bluetooth.h>
#include <zephyr/logging/log.h>
#include <zephyr/sys/reboot.h>
#include <dk_buttons_and_leds.h>

#include "data_out.h"
#include "ranging.h"

LOG_MODULE_REGISTER(app_main, LOG_LEVEL_INF);

// LED1 shows the link state and is driven by the role files. LED2 toggles once
// per distance result, so ranging can be seen working without a host attached.
#define SAMPLE_LED DK_LED2

static void on_sample(const struct range_sample *s)
{
	static bool led;

	data_out_sample(s);
	led = !led;
	dk_set_led(SAMPLE_LED, led);
}

int main(void)
{
	int err;

	data_out_build_info();
	dk_leds_init();

	err = bt_enable(NULL);
	if (err) {
		LOG_ERR("Bluetooth init failed (err %d)", err);
		return 0;
	}

	err = ranging_start(on_sample);
	if (err) {
		LOG_ERR("Ranging start failed (err %d), rebooting", err);
		// The board may be running from a power bank with nobody near it to press reset.
		k_sleep(K_SECONDS(2));
		sys_reboot(SYS_REBOOT_COLD);
	}

	return 0;
}
```

## src/data_out.c
```c
// Copyright (c) 2026 the ble-ranging authors
// SPDX-License-Identifier: MIT

#include <stdio.h>
#include <zephyr/kernel.h>
#include <zephyr/sys/printk.h>
#include <zephyr/bluetooth/bluetooth.h>
#include <zephyr/bluetooth/cs.h>
#include <app_version.h>

#include "data_out.h"

// Counts every $R line sent. A gap in this count on the host means a line was
// lost on the UART, which is different from a procedure lost on the radio.
static uint32_t line_n;

void data_out_info(const char *key, const char *value)
{
	printk("$I,%u,%s,%s\n", k_uptime_get_32(), key, value);
}

void data_out_info_int(const char *key, int value)
{
	printk("$I,%u,%s,%d\n", k_uptime_get_32(), key, value);
}

void data_out_build_info(void)
{
	data_out_info("fw", APP_VERSION_STRING);
	data_out_info("board", CONFIG_BOARD_TARGET);
	data_out_info("soc", CONFIG_SOC);
	data_out_info("role", IS_ENABLED(CONFIG_APP_ROLE_INITIATOR) ? "initiator" : "reflector");
	data_out_info("peer_name", CONFIG_APP_PEER_NAME);
}

static const char *phy_name(uint8_t phy)
{
	switch (phy) {
	case BT_GAP_LE_PHY_1M:
		return "1M";
	case BT_GAP_LE_PHY_2M:
		return "2M";
	case BT_GAP_LE_PHY_CODED:
		return "Coded";
	default:
		return "?";
	}
}

void data_out_conn(struct bt_conn *conn)
{
	struct bt_conn_info info;
	char addr[BT_ADDR_LE_STR_LEN];

	if (bt_conn_get_info(conn, &info)) {
		return;
	}

	bt_addr_le_to_str(info.le.local, addr, sizeof(addr));
	data_out_info("local_addr", addr);
	bt_addr_le_to_str(info.le.dst, addr, sizeof(addr));
	data_out_info("peer_addr", addr);
	data_out_info_int("conn_interval_us", info.le.interval_us);
	data_out_info_int("conn_latency", info.le.latency);
	data_out_info_int("conn_timeout_ms", info.le.timeout * 10);
	data_out_info_int("security_level", info.security.level);
	data_out_info_int("key_size", info.security.enc_key_size);
	data_out_info("phy_tx", phy_name(info.le.phy->tx_phy));
	data_out_info("phy_rx", phy_name(info.le.phy->rx_phy));
}

// The link can change PHY or timing after it is up, report every change.
static void phy_updated(struct bt_conn *conn, struct bt_conn_le_phy_info *param)
{
	data_out_info("phy_tx", phy_name(param->tx_phy));
	data_out_info("phy_rx", phy_name(param->rx_phy));
}

static void param_updated(struct bt_conn *conn, uint16_t interval, uint16_t latency,
			  uint16_t timeout)
{
	data_out_info_int("conn_interval_us", interval * 1250);
	data_out_info_int("conn_latency", latency);
	data_out_info_int("conn_timeout_ms", timeout * 10);
}

BT_CONN_CB_DEFINE(data_out_conn_cb) = {
	.le_phy_updated = phy_updated,
	.le_param_updated = param_updated,
};

void data_out_cs_caps(const struct bt_conn_le_cs_capabilities *c)
{
	data_out_info_int("peer_num_antennas", c->num_antennas_supported);
	data_out_info_int("peer_max_antenna_paths", c->max_antenna_paths_supported);
	data_out_info_int("peer_num_configs", c->num_config_supported);
	data_out_info_int("peer_initiator_ok", c->initiator_supported);
	data_out_info_int("peer_reflector_ok", c->reflector_supported);
	data_out_info_int("peer_mode3_ok", c->mode_3_supported);
	data_out_info_int("peer_sync_2m_ok", c->cs_sync_2m_phy_supported);
	data_out_info_int("peer_chsel_3c_ok", c->chsel_alg_3c_supported);
	data_out_info("peer_rtt_aa_precision",
		      c->rtt_aa_only_precision == BT_CONN_LE_CS_RTT_AA_ONLY_10NS    ? "10 ns"
		      : c->rtt_aa_only_precision == BT_CONN_LE_CS_RTT_AA_ONLY_150NS ? "150 ns"
										    : "none");
	data_out_info_int("peer_t_ip1_mask", c->t_ip1_times_supported);
}

// Writes the used CS channels as frequency ranges, like "2404-2424,2428-2478".
// CS channel k sits at 2402 + k MHz.
static void channel_ranges(const uint8_t map[10], char *out, size_t len, int *count)
{
	int start = -1;
	size_t used = 0;

	*count = 0;
	out[0] = '\0';
	for (int k = 0; k <= 79; k++) {
		bool on = k < 79 && BT_LE_CS_CHANNEL_BIT_GET(map, k);

		if (on) {
			(*count)++;
			if (start < 0) {
				start = k;
			}
		} else if (start >= 0) {
			used += snprintf(out + used, len - used, "%s%d-%d", used ? ";" : "",
					 2402 + start, 2402 + k - 1);
			start = -1;
			if (used >= len) {
				return;
			}
		}
	}
}

void data_out_cs_config(const struct bt_conn_le_cs_config *c)
{
	static const char *const rtt_types[] = {"AA only", "32 bit sounding", "96 bit sounding",
						"32 bit random", "64 bit random", "96 bit random",
						"128 bit random"};
	static const char *const sync_phys[] = {"?", "1M", "2M", "2M 2BT"};
	char buf[64];
	int n_channels;

	data_out_info_int("cs_config_id", c->id);
	data_out_info("cs_role", c->role == BT_CONN_LE_CS_ROLE_INITIATOR ? "initiator" : "reflector");
	data_out_info_int("cs_main_mode", BT_CONN_LE_CS_MODE_MAIN_MODE_PART(c->mode));
	data_out_info_int("cs_sub_mode", BT_CONN_LE_CS_MODE_SUB_MODE_PART(c->mode));
	data_out_info_int("cs_min_main_steps", c->min_main_mode_steps);
	data_out_info_int("cs_max_main_steps", c->max_main_mode_steps);
	data_out_info_int("cs_main_mode_repetition", c->main_mode_repetition);
	data_out_info_int("cs_mode0_steps", c->mode_0_steps);
	data_out_info("cs_rtt_type", c->rtt_type < ARRAY_SIZE(rtt_types) ? rtt_types[c->rtt_type] : "?");
	data_out_info("cs_sync_phy", c->cs_sync_phy < ARRAY_SIZE(sync_phys) ? sync_phys[c->cs_sync_phy] : "?");
	data_out_info_int("cs_channel_map_repetition", c->channel_map_repetition);
	data_out_info("cs_channel_selection", c->channel_selection_type == 0 ? "3b" : "3c");
	data_out_info_int("cs_t_ip1_us", c->t_ip1_time_us);
	data_out_info_int("cs_t_ip2_us", c->t_ip2_time_us);
	data_out_info_int("cs_t_fcs_us", c->t_fcs_time_us);
	data_out_info_int("cs_t_pm_us", c->t_pm_time_us);

	channel_ranges(c->channel_map, buf, sizeof(buf), &n_channels);
	data_out_info_int("cs_num_channels", n_channels);
	data_out_info("cs_channels_mhz", buf);
}

void data_out_cs_procedure(const struct bt_conn_le_cs_procedure_enable_complete *p)
{
	data_out_info_int("tx_power_dbm", p->selected_tx_power);
	data_out_info_int("antenna_config", p->tone_antenna_config_selection);
	data_out_info_int("subevent_len_us", p->subevent_len);
	data_out_info_int("subevents_per_event", p->subevents_per_event);
	data_out_info_int("subevent_interval", p->subevent_interval);
	data_out_info_int("event_interval", p->event_interval);
	data_out_info_int("procedure_interval", p->procedure_interval);
	data_out_info_int("procedure_count", p->procedure_count);
	data_out_info_int("max_procedure_len", p->max_procedure_len);
}

void data_out_sample(const struct range_sample *s)
{
	// Build the whole line first and print it once, so a log line from
	// another thread is less likely to land in the middle of it.
	char line[160];

	snprintk(line, sizeof(line), "$R,%u,%u,%u,%.3f,%.3f,%.3f,%.3f,%u,%u,%u,%d,%.3f,%.3f,%.3f\n",
		 line_n++, k_uptime_get_32(), s->counter, (double)s->ifft_m,
		 (double)s->phase_slope_m, (double)s->rtt_m, (double)s->best_m, s->tone_ok,
		 s->good_channels, s->rtt_count, s->rssi_dbm, (double)s->rtt_raw_m,
		 (double)s->best_med9_m, (double)s->cal_m);
	printk("%s", line);
}

// tokens already starts with a comma, or is empty if no mode 2 step came in.
void data_out_iq(uint16_t counter, uint8_t steps, const char *tokens)
{
	printk("$Q,%u,%u,%u%s\n", k_uptime_get_32(), counter, steps, tokens);
}
```

## src/data_out.h
```c
// Copyright (c) 2026 the ble-ranging authors
// SPDX-License-Identifier: MIT

#ifndef DATA_OUT_H_
#define DATA_OUT_H_

#include <zephyr/bluetooth/conn.h>

#include "ranging.h"

// Every machine readable line starts with '$' so a host script can pick them
// out from between the normal log lines.
//   $I,<uptime_ms>,<key>,<value>   facts about this build, the link and the radio
//   $R,<n>,<uptime_ms>,<counter>,<ifft_m>,<phase_slope_m>,<rtt_m>,<best_m>,
//      <tone_ok>,<good_channels>,<rtt_count>,<rssi_dbm>,<rtt_raw_m>,<best_med9_m>,<cal_m>
//   $Q,<uptime_ms>,<counter>,<steps>,<token>,<token>...   raw tones, see ranging_cs_initiator.c

void data_out_info(const char *key, const char *value);
void data_out_info_int(const char *key, int value);
void data_out_sample(const struct range_sample *s);
void data_out_iq(uint16_t counter, uint8_t steps, const char *tokens);

// Firmware version, board, chip and role of this build.
void data_out_build_info(void);

// Connection interval, latency, timeout, PHY, security as the link has them now.
void data_out_conn(struct bt_conn *conn);

// What the peer's radio says it can do for Channel Sounding.
void data_out_cs_caps(const struct bt_conn_le_cs_capabilities *c);

// The CS config both radios agreed on, including the channel list.
void data_out_cs_config(const struct bt_conn_le_cs_config *c);

// The timing the controllers settled on when procedures started.
void data_out_cs_procedure(const struct bt_conn_le_cs_procedure_enable_complete *p);

#endif
```

## src/ranging.h
```c
// Copyright (c) 2026 the ble-ranging authors
// SPDX-License-Identifier: MIT

#ifndef RANGING_H_
#define RANGING_H_

#include <stdbool.h>
#include <stdint.h>

// RSSI value used when no step carried one.
#define RANGE_RSSI_NONE 127

// One result per ranging procedure. Every radio backend fills this same struct,
// so a different backend (for example a BLE 5.4 one) can be added without
// changing main.c.
struct range_sample {
	uint16_t counter;      // procedure counter from the radio, 12 bits, wraps at 4096
	float ifft_m;          // distance from the IFFT method, NAN if it had no data
	float phase_slope_m;   // distance from the phase slope method, NAN if no data
	float rtt_m;           // distance from round trip time, NAN if no data
	float rtt_raw_m;       // same before Nordic clamps it at 0, can be negative
	float best_m;          // the library's pick of the three
	float best_med9_m;     // median of best_m over the last 9 procedures, as in Nordic's sample
	float cal_m;           // best_med9_m after the linear calibration in ranging_cs_initiator.c
	bool tone_ok;          // enough clean channels for the phase methods to be trusted
	uint8_t good_channels; // channels with at least one clean tone, out of 72
	uint8_t rtt_count;     // round trip steps that passed the quality checks
	int8_t rssi_dbm;       // mean RSSI over the round trip steps, or RANGE_RSSI_NONE
};

typedef void (*ranging_cb_t)(const struct range_sample *sample);

// Brings up the radio side for this build's role and returns once ranging
// is running. cb is called from the Bluetooth thread for every procedure.
// The reflector never produces samples, so it ignores cb.
int ranging_start(ranging_cb_t cb);

#endif
```

## src/ranging_cs_reflector.c
```c
// Copyright (c) 2024 Nordic Semiconductor ASA
// Modifications copyright (c) 2026 the ble-ranging authors
// SPDX-License-Identifier: LicenseRef-Nordic-5-Clause

// Channel Sounding reflector, based on Nordic's ras_reflector sample and reduced
// to the parts needed here.
//
// The reflector advertises, waits for the initiator to connect, then
// answers every sounding step. After each procedure the Ranging Service
// (RAS) sends its own step data back to the initiator over GATT, which is
// what lets the initiator work out the distance.

#include <zephyr/kernel.h>
#include <zephyr/bluetooth/bluetooth.h>
#include <zephyr/bluetooth/conn.h>
#include <zephyr/bluetooth/cs.h>
#include <zephyr/bluetooth/uuid.h>
#include <zephyr/sys/reboot.h>
#include <zephyr/logging/log.h>
#include <bluetooth/services/ras.h>
#include <dk_buttons_and_leds.h>

#include "data_out.h"
#include "ranging.h"

LOG_MODULE_REGISTER(cs_reflector, LOG_LEVEL_INF);

#define LINK_LED DK_LED1

static K_SEM_DEFINE(sem_connected, 0, 1);
static K_SEM_DEFINE(sem_config, 0, 1);

static struct bt_conn *connection;

static const struct bt_data ad[] = {
	BT_DATA_BYTES(BT_DATA_FLAGS, (BT_LE_AD_GENERAL | BT_LE_AD_NO_BREDR)),
	BT_DATA_BYTES(BT_DATA_UUID16_ALL, BT_UUID_16_ENCODE(BT_UUID_RANGING_SERVICE_VAL)),
	// The initiator filters on this exact name, both sides read it from the same Kconfig.
	BT_DATA(BT_DATA_NAME_COMPLETE, CONFIG_APP_PEER_NAME, sizeof(CONFIG_APP_PEER_NAME) - 1),
};

static void connected_cb(struct bt_conn *conn, uint8_t err)
{
	char addr[BT_ADDR_LE_STR_LEN];

	bt_addr_le_to_str(bt_conn_get_dst(conn), addr, sizeof(addr));
	LOG_INF("Connected to %s (err 0x%02X)", addr, err);

	if (err) {
		// Advertising has stopped by now. Reboot so it starts again without anyone pressing reset.
		sys_reboot(SYS_REBOOT_COLD);
	}

	connection = bt_conn_ref(conn);
	dk_set_led_on(LINK_LED);
	data_out_info("event", "connected");
	k_sem_give(&sem_connected);
}

static void disconnected_cb(struct bt_conn *conn, uint8_t reason)
{
	LOG_INF("Disconnected (reason 0x%02X)", reason);
	data_out_info_int("disconnect_reason", reason);

	bt_conn_unref(conn);
	connection = NULL;
	dk_set_led_off(LINK_LED);

	// A reboot returns the CS state to a known start, which is simpler than
	// tearing it down by hand. The initiator does the same.
	sys_reboot(SYS_REBOOT_COLD);
}

static void config_create_cb(struct bt_conn *conn, uint8_t status,
			     struct bt_conn_le_cs_config *config)
{
	if (status != BT_HCI_ERR_SUCCESS) {
		LOG_WRN("CS config creation failed (HCI status 0x%02x)", status);
		return;
	}

	LOG_INF("CS config %u created by the initiator, mode %u", config->id, config->mode);
	data_out_cs_config(config);
	k_sem_give(&sem_config);
}

static void security_changed_cb(struct bt_conn *conn, bt_security_t level,
				enum bt_security_err err)
{
	if (!err) {
		data_out_conn(conn);
	}
}

static void security_enable_cb(struct bt_conn *conn, uint8_t status)
{
	if (status == BT_HCI_ERR_SUCCESS) {
		LOG_INF("CS security enabled");
	} else {
		LOG_WRN("CS security enable failed (HCI status 0x%02x)", status);
	}
}

static void procedure_enable_cb(struct bt_conn *conn, uint8_t status,
				struct bt_conn_le_cs_procedure_enable_complete *params)
{
	if (status != BT_HCI_ERR_SUCCESS) {
		LOG_WRN("CS procedure enable failed (HCI status 0x%02x)", status);
		return;
	}

	LOG_INF("CS procedures %s", params->state ? "running" : "stopped");
	if (params->state) {
		data_out_cs_procedure(params);
	}
	data_out_info("event", params->state ? "ranging" : "stopped");
}

#if defined(CONFIG_APP_POWER_BANK_LOAD)
// Runs at the lowest priority, so Bluetooth and logging always run first. Its
// only job is to stop the CPU from sleeping, which keeps the current draw up.
static void load_thread(void)
{
	while (1) {
		k_yield();
	}
}

K_THREAD_DEFINE(load_tid, 512, load_thread, NULL, NULL, NULL,
		K_LOWEST_APPLICATION_THREAD_PRIO, 0, 0);
#endif

BT_CONN_CB_DEFINE(conn_cb) = {
	.connected = connected_cb,
	.disconnected = disconnected_cb,
	.security_changed = security_changed_cb,
	.le_cs_config_complete = config_create_cb,
	.le_cs_security_enable_complete = security_enable_cb,
	.le_cs_procedure_enable_complete = procedure_enable_cb,
};

int ranging_start(ranging_cb_t cb)
{
	int err;

	ARG_UNUSED(cb);

	if (IS_ENABLED(CONFIG_APP_POWER_BANK_LOAD)) {
		// LED1 stays the link LED, the other three are spare load.
		dk_set_led_on(DK_LED2);
		dk_set_led_on(DK_LED3);
		dk_set_led_on(DK_LED4);
	}

	err = bt_le_adv_start(BT_LE_ADV_CONN_FAST_2, ad, ARRAY_SIZE(ad), NULL, 0);
	if (err) {
		LOG_ERR("Advertising failed to start (err %d)", err);
		return err;
	}

	LOG_INF("Advertising as \"%s\"", CONFIG_APP_PEER_NAME);
	data_out_info("event", "advertising");

	k_sem_take(&sem_connected, K_FOREVER);

	const struct bt_le_cs_set_default_settings_param default_settings = {
		.enable_initiator_role = false,
		.enable_reflector_role = true,
		.cs_sync_antenna_selection = BT_LE_CS_ANTENNA_SELECTION_OPT_REPETITIVE,
		.max_tx_power = BT_HCI_OP_LE_CS_MAX_MAX_TX_POWER,
	};

	err = bt_le_cs_set_default_settings(connection, &default_settings);
	if (err) {
		LOG_ERR("Failed to set default CS settings (err %d)", err);
		return err;
	}

	// The initiator creates the config. The reflector waits for it, then sets wide
	// limits so that the timing chosen by the initiator always fits.
	k_sem_take(&sem_config, K_FOREVER);

	const struct bt_le_cs_set_procedure_parameters_param procedure_params = {
		.config_id = 0,
		.max_procedure_len = 1000,
		.min_procedure_interval = 1,
		.max_procedure_interval = 100,
		.max_procedure_count = 0,
		.min_subevent_len = 10000,
		.max_subevent_len = 75000,
		.tone_antenna_config_selection = BT_LE_CS_TONE_ANTENNA_CONFIGURATION_A1_B1,
		.phy = BT_LE_CS_PROCEDURE_PHY_2M,
		.tx_power_delta = 0x80,
		.preferred_peer_antenna = BT_LE_CS_PROCEDURE_PREFERRED_PEER_ANTENNA_1,
		.snr_control_initiator = BT_LE_CS_SNR_CONTROL_NOT_USED,
		.snr_control_reflector = BT_LE_CS_SNR_CONTROL_NOT_USED,
	};

	err = bt_le_cs_set_procedure_parameters(connection, &procedure_params);
	if (err) {
		LOG_ERR("Failed to set procedure parameters (err %d)", err);
		return err;
	}

	return 0;
}
```
